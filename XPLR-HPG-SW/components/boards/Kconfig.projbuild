## XPLR-HPG-SW/components/boards/Kconfig.projbuild
```kconfig
menu "Board Options"

    choice BOARD_TARGET
        prompt "Choose Target Board"
            default BOARD_XPLR_HPG2_C214

        config BOARD_XPLR_HPG2_C214
            bool "XPLR HPG2 C214 (NINA-W106)"

        config BOARD_XPLR_HPG1_C213
            bool "XPLR HPG1 C213 (NORA-W106)"

        config BOARD_MAZGCH_HPG_SOLUTION
            bool "MAZGCH HPG SOLUTION (NINA-W106)"

    endchoice

    choice GNSS_MODULE
        prompt "Choose GNSS Module"
            default GNSS_MODULE_ZED_F9R
            config GNSS_MODULE_ZED_F9R
                bool "ZED-F9R"
            config GNSS_MODULE_ZED_F9P
                bool "ZED-F9P"
            config GNSS_MODULE_NONE
                bool "NONE"

    endchoice

    config GNSS_MODULE
        int
        default 0 if GNSS_MODULE_ZED_F9R
        default 1 if GNSS_MODULE_ZED_F9P
        default -1 if GNSS_MODULE_NONE

endmenu
```

## XPLR-HPG-SW/examples/cellular/01_hpg_cell_register/main/Kconfig.projbuild
```kconfig
menu "XPLR HPG Options"

    menu "Cellular Settings"
        config XPLR_CELL_APN
            string "APN value of cellular provider"
            default "internet"
            help
                type in the APN of your cellular provider.
    endmenu

endmenu
```

## XPLR-HPG-SW/examples/cellular/02_hpg_cell_mqtt_correction_certs/main/Kconfig.projbuild
```kconfig
menu "XPLR HPG Options"
    
    menu "Dead Reckoning"
        choice XPLR_GNSS_DEADRECKONING_ENABLE
            prompt "Dead reckoning state"
            config XPLR_DR_OPT_DISABLE
                bool "Disable"
            config XPLR_DR_OPT_ENABLE
                bool "Enable"
        endchoice
        
        config XPLR_GNSS_DEADRECKONING_ENABLE
            int
            default 0 if XPLR_DR_OPT_DISABLE
            default 1 if XPLR_DR_OPT_ENABLE
    endmenu

    menu "Correction Data Source"
        choice XPLR_CORRECTION_DATA_SOURCE
            prompt "Choose correction data source for your GNSS module"
            default CORRECTION_VIA_IP
            config CORRECTION_VIA_IP
                bool "Correction via IP"
            config CORRECTION_VIA_LBAND
                bool "Correction via LBAND"
        endchoice

        config XPLR_CORRECTION_DATA_SOURCE
            int 
            default 0 if CORRECTION_VIA_IP
            default 1 if CORRECTION_VIA_LBAND
    endmenu
    
    menu "Cellular Settings"
        config XPLR_CELL_APN
            string "APN value of cellular provider"
            default "internet"
            help
                type in the APN of your cellular provider.
    endmenu

    menu "MQTT Settings"

        config XPLR_MQTTCELL_THINGSTREAM_HOSTNAME
            string "Broker hostname"
            default "pp.services.u-blox.com:8883"
            help
                Sets the url for the MQTT Broker Address.<br>
                Default value is recommended unless there's a change in the official docs.<br>

        config XPLR_MQTTCELL_CLIENT_ID
            string "Client ID"
            default "Client-ID"
            help
                Sets the MQTT Client ID according to Thingstream Client ID value.<br>

    endmenu

endmenu
```

## XPLR-HPG-SW/examples/cellular/03_hpg_cell_mqtt_correction_ztp/main/Kconfig.projbuild
```kconfig
menu "XPLR HPG Options"

    menu "Dead Reckoning"
        choice XPLR_GNSS_DEADRECKONING_ENABLE
            prompt "Dead reckoning state"
            config XPLR_DR_OPT_DISABLE
                bool "Disable"
            config XPLR_DR_OPT_ENABLE
                bool "Enable"
        endchoice
        
        config XPLR_GNSS_DEADRECKONING_ENABLE
            int
            default 0 if XPLR_DR_OPT_DISABLE
            default 1 if XPLR_DR_OPT_ENABLE
    endmenu

    menu "Cellular Settings"
        config XPLR_CELL_APN
            string "APN value of cellular provider"
            default "internet"
            help
                type in the APN of your cellular provider.
    endmenu

    menu "AWS Root CA Settings"
        config XPLR_AWS_ROOTCA_URL
            string "AWS root ca url"
            default "www.amazontrust.com:443"
            help
                Fill in the url and port used for retrieving the root ca.

        config XPLR_AWS_ROOTCA_PATH
            string "AWS root ca path"
            default "/repository/AmazonRootCA1.pem"
            help
                Fill in the path to the root ca url.
    endmenu

    menu "Thingstream Zero Touch Provisioning Settings"

        config XPLR_TS_PP_ZTP_TOKEN
            string "ZTP Thingstream token"
            default "ztp-token"
            help
                Type in the ZTP token from your Thingstream account.
    endmenu

endmenu
```

## XPLR-HPG-SW/examples/cellular/04_hpg_cell_ntrip_correction/main/Kconfig.projbuild
```kconfig
menu "XPLR HPG Options"

    menu "Dead Reckoning"
        choice XPLR_GNSS_DEADRECKONING_ENABLE
            prompt "Dead reckoning state"
            config XPLR_DR_OPT_DISABLE
                bool "Disable"
            config XPLR_DR_OPT_ENABLE
                bool "Enable"
        endchoice
        
        config XPLR_GNSS_DEADRECKONING_ENABLE
            int
            default 0 if XPLR_DR_OPT_DISABLE
            default 1 if XPLR_DR_OPT_ENABLE
    endmenu

    menu "Cellular Settings"
        config XPLR_CELL_APN
            string "APN value of cellular provider"
            default "internet"
            help
                type in the APN of your cellular provider.
    endmenu

    menu "NTRIP Client Settings"
        config XPLR_CELL_NTRIP_HOST
            string "NTRIP caster URL/IP address"
            default "host"
            help
                URL/IP adress of your NTRIP caster

        config XPLR_CELL_NTRIP_PORT
            int "NTRIP caster port"
            default 2101
            help
                Which port to use in order to access the NTRIP caster

        config XPLR_CELL_NTRIP_MOUNTPOINT
            string "NTRIP caster mountpoint"
            default "mountpoint"
            help
                Which mountpoint to use

        config XPLR_CELL_NTRIP_USERAGENT
            string "User-Agent"
            default "NTRIP_XPLR_HPG"
            help
                User-Agent to identify the device
            
        config XPLR_CELL_NTRIP_GGA_MSG
            bool "Send GGA message"
            default y
            help
                Select only if your caster requires the client to send periodic GGA message

        config XPLR_CELL_NTRIP_USE_AUTH
            bool "Use authentication"
            default y
            help
                Select only if your caster requires authentication

        config XPLR_CELL_NTRIP_USERNAME
            string "Username"
            default "username"
            help
                Will use only if "Use authentication" option is set to True

        config XPLR_CELL_NTRIP_PASSWORD
            string "Password"
            default "password"
            help
                Will use only if "Use authentication" option is set to True
    endmenu
endmenu
```

## XPLR-HPG-SW/examples/positioning/01_hpg_gnss_config/main/Kconfig.projbuild
```kconfig
menu "XPLR HPG Options"

    menu "Dead Reckoning"
        choice XPLR_GNSS_DEADRECKONING_ENABLE
            prompt "Dead reckoning state"
            config XPLR_DR_OPT_DISABLE
                bool "Disable"
            config XPLR_DR_OPT_ENABLE
                bool "Enable"
        endchoice
        
        config XPLR_GNSS_DEADRECKONING_ENABLE
            int
            default 0 if XPLR_DR_OPT_DISABLE
            default 1 if XPLR_DR_OPT_ENABLE
    endmenu
    
endmenu
```

## XPLR-HPG-SW/examples/shortrange/02_hpg_wifi_http_ztp/main/Kconfig.projbuild
```kconfig
menu "XPLR HPG Options"

    menu "AWS Root CA Settings"
        config XPLR_AWS_ROOTCA_URL
            string "AWS Root CA Url"
            default "https://www.amazontrust.com/repository/AmazonRootCA1.pem"
            help
                Amazon Url in order to fetch the Root CA certificate. If not using a different Root CA certificate leave to default value.
    endmenu
    
    menu "Thingstream Zero Touch Provisioning Settings"
        config XPLR_TS_PP_ZTP_CREDENTIALS_URL
            string "ZTP Thingstream credentials URL"
            default "https://api.thingstream.io/ztp/pointperfect/credentials"
            help
                Sets the URL for the WEB API to fetch Poin Perfect ZTP payload.<br>
                Default value is recommended unless there's a change in the official docs.

        config XPLR_TS_PP_ZTP_TOKEN
            string "ZTP Thingstream token"
            default "ztp-token"
            help
                Type in the ZTP token from your Thingstream account.
    endmenu

    menu "Wi-Fi Settings"
        config XPLR_WIFI_SSID
            string "Access Point SSID"
            default "ssid"
            help
                Fill in the AP SSID you wish to connect to.

        config XPLR_WIFI_PASSWORD
            string "Access Point Password"
            default "password"
            help
                Fill in the AP SSID you wish to connect to.
    endmenu

endmenu
```

## XPLR-HPG-SW/examples/shortrange/03_hpg_wifi_mqtt_correction_certs/main/Kconfig.projbuild
```kconfig
menu "XPLR HPG Options"

    menu "Dead Reckoning"
        choice XPLR_GNSS_DEADRECKONING_ENABLE
            prompt "Dead reckoning state"
            config XPLR_DR_OPT_DISABLE
                bool "Disable"
            config XPLR_DR_OPT_ENABLE
                bool "Enable"
        endchoice
        
        config XPLR_GNSS_DEADRECKONING_ENABLE
            int
            default 0 if XPLR_DR_OPT_DISABLE
            default 1 if XPLR_DR_OPT_ENABLE
    endmenu

    menu "Correction Data Source"
        choice XPLR_CORRECTION_DATA_SOURCE
            prompt "Choose correction data source for your GNSS module"
            default CORRECTION_VIA_IP
            config CORRECTION_VIA_IP
                bool "Correction via IP"
            config CORRECTION_VIA_LBAND
                bool "Correction via LBAND"
        endchoice

        config XPLR_CORRECTION_DATA_SOURCE
            int 
            default 0 if CORRECTION_VIA_IP
            default 1 if CORRECTION_VIA_LBAND
    endmenu

    menu "MQTT Settings"
        config XPLR_MQTTWIFI_THINGSTREAM_HOSTNAME
            string "Broker hostname"
            default "mqtts://pp.services.u-blox.com"
            help
                Sets the url for the MQTT Broker Address.<br>
                Default value is recommended unless there's a change in the official docs.<br>
                Can be overwritten when using Zero Touch Provisionning (ZTP).

        config XPLR_MQTTWIFI_CLIENT_ID
            string "Client ID"
            default "Client-ID"
            help
                Sets the MQTT Client ID according to Thingstream Client ID value.<br>
                Can be overwritten when using Zero Touch Provisionning (ZTP).
    endmenu

    menu "Wi-Fi Settings"
        config XPLR_WIFI_SSID
            string "Access Point SSID"
            default "ssid"
            help
                Fill in the AP SSID you wish to connect to.

        config XPLR_WIFI_PASSWORD
            string "Access Point Password"
            default "password"
            help
                Fill in the AP SSID you wish to connect to.
    endmenu

endmenu
```

## XPLR-HPG-SW/examples/shortrange/04_hpg_wifi_mqtt_correction_ztp/main/Kconfig.projbuild
```kconfig
menu "XPLR HPG Options"

    menu "Dead Reckoning"
        choice XPLR_GNSS_DEADRECKONING_ENABLE
            prompt "Dead reckoning state"
            config XPLR_DR_OPT_DISABLE
                bool "Disable"
            config XPLR_DR_OPT_ENABLE
                bool "Enable"
        endchoice
        
        config XPLR_GNSS_DEADRECKONING_ENABLE
            int
            default 0 if XPLR_DR_OPT_DISABLE
            default 1 if XPLR_DR_OPT_ENABLE
    endmenu

    menu "Correction Data Source"
        choice XPLR_CORRECTION_DATA_SOURCE
            prompt "Choose correction data source for your GNSS module"
            default CORRECTION_VIA_IP
            config CORRECTION_VIA_IP
                bool "Correction via IP"
            config CORRECTION_VIA_LBAND
                bool "Correction via LBAND"
        endchoice

        config XPLR_CORRECTION_DATA_SOURCE
            int 
            default 0 if CORRECTION_VIA_IP
            default 1 if CORRECTION_VIA_LBAND
    endmenu

    menu "AWS Root CA Settings"
        config XPLR_AWS_ROOTCA_URL
            string "AWS Root CA Url"
            default "https://www.amazontrust.com/repository/AmazonRootCA1.pem"
            help
                Amazon Url in order to fetch the Root CA certificate. If not using a different Root CA certificate leave to default value.
    endmenu
            
    menu "Thingstream Zero Touch Provisioning Settings"
        config XPLR_TS_PP_ZTP_TOKEN
            string "ZTP Thingstream token"
            default "ztp-token"
            help
                Type in the ZTP token from your Thingstream account.
    endmenu

    menu "Wi-Fi Settings"
        config XPLR_WIFI_SSID
            string "Access Point SSID"
            default "ssid"
            help
                Fill in the AP SSID you wish to connect to.

        config XPLR_WIFI_PASSWORD
            string "Access Point Password"
            default "password"
            help
                Fill in the AP SSID you wish to connect to.
    endmenu

endmenu
```

## XPLR-HPG-SW/examples/shortrange/05_hpg_wifi_mqtt_correction_captive_portal/main/Kconfig.projbuild
```kconfig
menu "XPLR HPG Options"

    menu "Wi-Fi Settings"
        config XPLR_WIFI_SSID
            string "Access Point SSID"
            default "ssid"
            help
                AP SSID you wish to connect to.

        config XPLR_WIFI_PASSWORD
            string "Access Point Password"
            default "password"
            help
                AP password you wish to connect to.

        config XPLR_MDNS_HOSTNAME
            string "mDNS Hostname"
            default "xplr-hpg"
            help
                mDNS Hostname for example to use

        config XPLR_MDNS_INSTANCE
            string "mDNS Instance Name"
            default "U-Blox XPLR-HPG kit"
            help
                mDNS Instance Name for example to use

        config XPLR_MDNS_ADD_MAC_TO_HOSTNAME
            bool "Add mac suffix to hostname"
            default n
            help
                If enabled, a portion of MAC address is added to the hostname
    endmenu

endmenu
```
