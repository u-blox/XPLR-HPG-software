## XPLR-HPG-SW/examples/shortrange/07_hpg_wifi_mqtt_correction_sd_config_file/main/Kconfig.projbuild
```kconfig
menu "XPLR HPG Options"

    menu "Dead Reckoning"
        choice XPLR_GNSS_DEADRECKONING_ENABLE
            prompt "Dead reckoning state"
            config XPLR_DR_OPT_DISABLE
                bool "Disable"
            config XPLR_DR_OPT_ENABLE
                bool "Enable"
        endchoice
        
        config XPLR_GNSS_DEADRECKONING_ENABLE
            int
            default 0 if XPLR_DR_OPT_DISABLE
            default 1 if XPLR_DR_OPT_ENABLE
    endmenu

    menu "Correction Data Source"
        choice XPLR_CORRECTION_DATA_SOURCE
            prompt "Choose correction data source for your GNSS module"
            default CORRECTION_VIA_IP
            config CORRECTION_VIA_IP
                bool "Correction via IP"
            config CORRECTION_VIA_LBAND
                bool "Correction via LBAND"
        endchoice

        config XPLR_CORRECTION_DATA_SOURCE
            int 
            default 0 if CORRECTION_VIA_IP
            default 1 if CORRECTION_VIA_LBAND
    endmenu

    menu "Wi-Fi Settings"
        config XPLR_WIFI_SSID
            string "Access Point SSID"
            default "ssid"
            help
                Fill in the AP SSID you wish to connect to.

        config XPLR_WIFI_PASSWORD
            string "Access Point Password"
            default "password"
            help
                Fill in the AP SSID you wish to connect to.
    endmenu

    menu "u-center Config"
        config XPLR_UCENTER_CONFIG_FILENAME
            string "u-center Config Filename"
            default "device-deviceID-ucenter-config.json"
            help
                Fill in the u-center config filename located in the SD card.
    endmenu

endmenu
```

## XPLR-HPG-SW/examples/shortrange/08_hpg_bluetooth/main/Kconfig.projbuild
```kconfig
menu "XPLR HPG Options"
    menu "Bluetooth Settings"
        config XPLR_BLUETOOTH_DEVICE_NAME
            string "Device name"
            default "xplr-hpg"
            help
                Fill in the Bluetooth device name
    endmenu
endmenu
```

## XPLR-HPG-SW/sdkconfig.defaults
```kconfig
#
# FreeRTOS
#
CONFIG_FREERTOS_HZ=1000
CONFIG_FREERTOS_PLACE_FUNCTIONS_INTO_FLASH=y

#
# Memory
#
CONFIG_ESP_SYSTEM_EVENT_TASK_STACK_SIZE=8192
CONFIG_ESP_MAIN_TASK_STACK_SIZE=16384

#
# ESPTOOLPY
#
CONFIG_ESPTOOLPY_FLASHSIZE_8MB=y
CONFIG_ESPTOOLPY_FLASHSIZE_DETECT=n

#
# Set log level
#
CONFIG_BOOTLOADER_LOG_LEVEL_INFO=y



#
# mbedTLS
#
CONFIG_MBEDTLS_DYNAMIC_BUFFER=y
CONFIG_MBEDTLS_DYNAMIC_FREE_PEER_CERT=y
CONFIG_MBEDTLS_DYNAMIC_FREE_CONFIG_DATA=y
CONFIG_MBEDTLS_DYNAMIC_FREE_CA_CERT=y

#
# HTTP Server
#
CONFIG_HTTPD_MAX_REQ_HDR_LEN=1024
CONFIG_HTTPD_MAX_URI_LEN=1024
CONFIG_HTTPD_ERR_RESP_NO_DELAY=y
CONFIG_HTTPD_PURGE_BUF_LEN=32
CONFIG_HTTPD_WS_SUPPORT=y

#
# Websocket
#
CONFIG_WS_BUFFER_SIZE=5500

#
# ESP HTTPS server
#
CONFIG_ESP_HTTPS_SERVER_ENABLE=y
# end of ESP HTTPS server

#
# LWIP
#
CONFIG_LWIP_LOCAL_HOSTNAME="xplrHpg"
# CONFIG_LWIP_NETIF_API is not set
# CONFIG_LWIP_TCPIP_CORE_LOCKING is not set
CONFIG_LWIP_DNS_SUPPORT_MDNS_QUERIES=y
# CONFIG_LWIP_L2_TO_L3_COPY is not set
# CONFIG_LWIP_IRAM_OPTIMIZATION is not set
CONFIG_LWIP_TIMERS_ONDEMAND=y
CONFIG_LWIP_MAX_SOCKETS=16
# CONFIG_LWIP_USE_ONLY_LWIP_SELECT is not set
# CONFIG_LWIP_SO_LINGER is not set
CONFIG_LWIP_SO_REUSE=y
CONFIG_LWIP_SO_REUSE_RXTOALL=y
# CONFIG_LWIP_SO_RCVBUF is not set
# CONFIG_LWIP_NETBUF_RECVINFO is not set
CONFIG_LWIP_IP4_FRAG=y
CONFIG_LWIP_IP6_FRAG=y
# CONFIG_LWIP_IP4_REASSEMBLY is not set
# CONFIG_LWIP_IP6_REASSEMBLY is not set
# CONFIG_LWIP_IP_FORWARD is not set
# CONFIG_LWIP_STATS is not set
# CONFIG_LWIP_ETHARP_TRUST_IP_MAC is not set
CONFIG_LWIP_ESP_GRATUITOUS_ARP=y
CONFIG_LWIP_GARP_TMR_INTERVAL=60
CONFIG_LWIP_TCPIP_RECVMBOX_SIZE=32
CONFIG_LWIP_DHCP_DOES_ARP_CHECK=y
# CONFIG_LWIP_DHCP_DISABLE_CLIENT_ID is not set
CONFIG_LWIP_DHCP_DISABLE_VENDOR_CLASS_ID=y
# CONFIG_LWIP_DHCP_RESTORE_LAST_IP is not set
CONFIG_LWIP_DHCP_OPTIONS_LEN=68

#
# DHCP server
#
CONFIG_LWIP_DHCPS=y
CONFIG_LWIP_DHCPS_LEASE_UNIT=60
CONFIG_LWIP_DHCPS_MAX_STATION_NUM=8
# end of DHCP server

#
# Wear Levelling
#
CONFIG_WL_SECTOR_SIZE_512=y
# CONFIG_WL_SECTOR_SIZE_4096 is not set
CONFIG_WL_SECTOR_SIZE=512
# CONFIG_WL_SECTOR_MODE_PERF is not set
CONFIG_WL_SECTOR_MODE_SAFE=y
CONFIG_WL_SECTOR_MODE=1
# end of Wear Levelling

#
# Trace Facility (for vTaskList)
#
CONFIG_FREERTOS_USE_TRACE_FACILITY=y
CONFIG_FREERTOS_USE_STATS_FORMATTING_FUNCTIONS=y


#
# Bluetooth
#

####################
# BLE config START #
####################
#CONFIG_BT_ENABLED=y
#CONFIG_BTDM_CTRL_MODE_BLE_ONLY=y
#CONFIG_NIMBLE_ENABLED=y
#CONFIG_BTDM_CTRL_BLE_MAX_CONN=3
#CONFIG_BTDM_CTRL_BLE_MAX_CONN_EFF=3
#CONFIG_BT_NIMBLE_MAX_CONNECTIONS=3
#CONFIG_BT_NIMBLE_LOG_LEVEL_ERROR=y
#CONFIG_BT_NIMBLE_LOG_LEVEL=3
##################
# BLE config END #
##################

###########################
# BT Classic config START #
# Only available in HPG-2 boards
# (NINA-W1 variant)
###########################
#CONFIG_BT_ENABLED=y
#CONFIG_BTDM_CTRL_MODE_BR_EDR_ONLY=y
#CONFIG_BT_BLUEDROID_ENABLED=y
#CONFIG_BT_CLASSIC_ENABLED=y
#CONFIG_BT_SPP_ENABLED=y
#CONFIG_BT_SSP_ENABLED=y
#CONFIG_BT_STACK_NO_LOG=y
###########################
# BT Classic config END #
###########################

#
# Partition Table
#
# CONFIG_PARTITION_TABLE_SINGLE_APP is not set
# CONFIG_PARTITION_TABLE_SINGLE_APP_LARGE is not set
# CONFIG_PARTITION_TABLE_TWO_OTA is not set
CONFIG_PARTITION_TABLE_CUSTOM=y
CONFIG_PARTITION_TABLE_CUSTOM_FILENAME="partitions_hpg.csv"
CONFIG_PARTITION_TABLE_FILENAME="partitions_hpg.csv"
CONFIG_PARTITION_TABLE_OFFSET=0x8000
CONFIG_PARTITION_TABLE_MD5=y
# end of Partition Table

#
# FAT Filesystem support
#
# CONFIG_FATFS_CODEPAGE_DYNAMIC is not set
CONFIG_FATFS_CODEPAGE_437=y
# CONFIG_FATFS_CODEPAGE_720 is not set
# CONFIG_FATFS_CODEPAGE_737 is not set
# CONFIG_FATFS_CODEPAGE_771 is not set
# CONFIG_FATFS_CODEPAGE_775 is not set
# CONFIG_FATFS_CODEPAGE_850 is not set
# CONFIG_FATFS_CODEPAGE_852 is not set
# CONFIG_FATFS_CODEPAGE_855 is not set
# CONFIG_FATFS_CODEPAGE_857 is not set
# CONFIG_FATFS_CODEPAGE_860 is not set
# CONFIG_FATFS_CODEPAGE_861 is not set
# CONFIG_FATFS_CODEPAGE_862 is not set
# CONFIG_FATFS_CODEPAGE_863 is not set
# CONFIG_FATFS_CODEPAGE_864 is not set
# CONFIG_FATFS_CODEPAGE_865 is not set
# CONFIG_FATFS_CODEPAGE_866 is not set
# CONFIG_FATFS_CODEPAGE_869 is not set
# CONFIG_FATFS_CODEPAGE_932 is not set
# CONFIG_FATFS_CODEPAGE_936 is not set
# CONFIG_FATFS_CODEPAGE_949 is not set
# CONFIG_FATFS_CODEPAGE_950 is not set
CONFIG_FATFS_CODEPAGE=437
# CONFIG_FATFS_LFN_NONE is not set
CONFIG_FATFS_LFN_HEAP=y
# CONFIG_FATFS_LFN_STACK is not set
CONFIG_FATFS_MAX_LFN=64
CONFIG_FATFS_API_ENCODING_ANSI_OEM=y
# CONFIG_FATFS_API_ENCODING_UTF_16 is not set
# CONFIG_FATFS_API_ENCODING_UTF_8 is not set
CONFIG_FATFS_FS_LOCK=2
CONFIG_FATFS_TIMEOUT_MS=10000
# CONFIG_FATFS_PER_FILE_CACHE is not set
# CONFIG_FATFS_USE_FASTSEEK is not set
# end of FAT Filesystem support
```
